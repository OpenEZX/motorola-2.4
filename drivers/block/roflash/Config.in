## drivers/power_ic/Kconfig
```kconfig
# Copyright 2005 - Motorola
#
# Character device configuration
#

source drivers/power_ic/core/Kconfig
```

## drivers/power_ic/core/Kconfig
```kconfig
# /vobs/ezx_linux/code/linux/linux-2.4.17/drivers/power_ic/core/Kconfig
#
# Description - Character device configuration.
#
# Copyright (C) 2005 - 2006  Motorola Inc.
#
#  This program is free software; you can redistribute it and/or modify
#  it under the terms of the GNU General Public License version 2 as
#  published by the Free Software Foundation.
#
#  This program is distributed in the hope that it will be useful,
#  but WITHOUT ANY WARRANTY; without even the implied warranty of
#  MERCHANTABILITY or FITNESS FOR A PARTICULAR PURPOSE.  See the
#  GNU General Public License for more details.
#
#  You should have received a copy of the GNU General Public License
#  along with this program; if not, write to the Free Software
#  Foundation, Inc., 59 Temple Place, Suite 330, Boston, MA  02111-1307  USA
#
# Motorola 2005-Mar-25 - File re-written from scratch
# Motorola 2006-Jan-27 - Add USR_BLK_DEV

menu "Power IC support"

config MOT_POWER_IC
	tristate "Motorola Power IC"
    depends on MXC_ATLAS
    ---help---
    This configuration enables the Power IC to be used by SCM-A11

config MOT_POWER_IC_ATLAS
	tristate "Motorola Power IC"
    depends on MOT_POWER_IC
    ---help---
    This configuration enables the Atlas to be used by SCM-A11 without affecting EzX	

config USR_BLK_DEV
	tristate "SD TransFlash support"
	depends on MOT_POWER_IC
	---help---
	This configuration enables SD TransFlash driver support for SCM-A11
endmenu
```

## drivers/usbd/Config.in
```kconfig
#
# USB device configuration from the device viewpoint (e.g. Linux running inside a USB device, not as host)
#
# Copyright (c) 2002-2003 Belcarra
#
#
# Copyright (C) 2005-2006 Motorola Inc.
#
#  Author     Date                Comment
# ======== ===========   =====================================================
#                        add dsplog support   for EZX platform
#                        add network support   for EZX platform
#                        add usb2.0 support  for EZX platform
#                        add External USB enumerate for Factory switch b plus test , for EZX platform
# Motorola 2006-Mar-09 - Fix webcamera unfluent in large resolution.
# Motorola 2006-Jul-03 - Merge OSS cleanup to macau in kernel. 
# Motorola 2006-Aug-10 - Resolve all the OSS related issues.
#


mainmenu_option next_comment

comment 'USB clients (devices, not hosts)'

tristate 'Support for USB Clients (USB Device, not USB Host)' CONFIG_USBD

if [ "$CONFIG_USBD" = "y" -o "$CONFIG_USBD" = "m" ]; then
   comment ''
   bool   '   Enable High Speed Descriptors' CONFIG_USBD_HIGH_SPEED

   bool   '   Enable Interface Association Descriptors' CONFIG_USBD_IAD

   bool   '   Do Not Use Serial Number in Device Descriptor (Default is no' CONFIG_USBD_NO_SERIAL_NUMBER
   if [ "$CONFIG_USBD_NO_SERIAL_NUMBER" != "y" ]; then
      string '  Default Serial number (string)' CONFIG_USBD_SERIAL_NUMBER_STR ""
   fi

   int '   Max Power (mA) (Default is zero, whick is self powered)' CONFIG_USBD_MAXPOWER "0"

   comment ''

   bool   '  USBD Proc FS' CONFIG_USBD_PROCFS

   tristate   '  USBD Proc FS Module' CONFIG_USBD_PROCFSM $CONFIG_USBD

   comment 'Function Drivers'

   source drivers/usbd/network_fd/Config.in
   source drivers/usbd/acm_fd/Config.in

   source drivers/usbd/mouse_fd/Config.in
   source drivers/usbd/storage_fd/Config.in

   source drivers/usbd/UVC_fd/Config.in

   comment 'Bus Interface'

   source drivers/usbd/pxa_bi/Config.in
   source drivers/usbd/wmmx_bi/Config.in
   source drivers/usbd/isp_bi/Config.in

   bool '  USB Device Register Tracing' CONFIG_USBD_BI_REGISTER_TRACE
   if [ "$CONFIG_USBD" = "y" ]; then
      bool '  USB Device Manual Enable' CONFIG_USBD_BI_DELAY_ENABLE
   fi

   source drivers/usbd/pst_fd/Config.in
   source drivers/usbd/cfg11_fd/Config.in
   #source drivers/usbd/gen_bi/Config.in
   #source drivers/usbd/l7205_bi/Config.in
   #source drivers/usbd/sl11_bi/Config.in

   #source drivers/usbd/cdc_fd/Config.in
   #source drivers/usbd/serialnumber/Config.in
   #source drivers/usbd/audio_fd/Config.in
   #source drivers/usbd/eg_fd/Config.in
   #source drivers/usbd/keyboard_fd/Config.in
   source drivers/usbd/dsplog_fd/Config.in
   source drivers/usbd/nm_fd/Config.in

   commnet 'External USB enumerate for Factory switch b plus test'
   dep_tristate '  Enternal USB b plus test' CONFIG_ARCH_EZX_SUPPORT_EXT_USB20 $CONFIG_USBD
fi

endmenu
```
